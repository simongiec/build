## conf/bblayers.conf
```bitbake
# POKY_BBLAYERS_CONF_VERSION is increased each time build/conf/bblayers.conf
# changes incompatibly
POKY_BBLAYERS_CONF_VERSION = "2"

BBPATH = "${TOPDIR}"
BBFILES ?= ""

BBLAYERS ?= " \
  ${TOPDIR}/../poky/meta \
  ${TOPDIR}/../poky/meta-poky \
  ${TOPDIR}/../poky/meta-yocto-bsp \
  ${TOPDIR}/../meta-openembedded/meta-oe \
  ${TOPDIR}/../meta-openembedded/meta-multimedia \
  ${TOPDIR}/../meta-openembedded/meta-python \
  ${TOPDIR}/../meta-openembedded/meta-networking \
  ${TOPDIR}/../meta-rockchip \
  "


DISPLAY_PLATFORM ?= "wayland"

DISTRO_FEATURES:append = " ${@d.getVar('DISPLAY_PLATFORM')}"
DISTRO_FEATURES:remove = " ${@'x11' if d.getVar('DISPLAY_PLATFORM') == 'wayland' else 'wayland'}"
IMAGE_FEATURES:append = " ${@'x11-base' if d.getVar('DISPLAY_PLATFORM') == 'x11' else ''}"
IMAGE_INSTALL:append = " ${@'weston weston-init weston-examples' if d.getVar('DISPLAY_PLATFORM') == 'wayland' else 'xf86-video-modesetting xserver-xorg-module-exa'}"

# For mali gpu
DISTRO_FEATURES:append = " egl"

#RK_OVERLAY_DIRS:append = " \
#	${TOPDIR}/../meta-rockchip/bt \
#"
# For adb
IMAGE_INSTALL:append = " android-tools-adbd"
PREFERRED_PROVIDER_android-tools-conf = "android-tools-conf-rockchip"
USB_DEBUGGING_ENABLED = "1"
```
